## conf/layer.conf
```bitbake
# We have a conf and classes directory, add to BBPATH
BBPATH .= ":${LAYERDIR}"

# We have recipes-* directories, add to BBFILES
BBFILES += "${LAYERDIR}/recipes-*/*/*.bb \
            ${LAYERDIR}/recipes-*/*/*.bbappend"

BBFILE_COLLECTIONS += "meta-odroidm1s"
BBFILE_PATTERN_meta-odroidm1s = "^${LAYERDIR}/"
BBFILE_PRIORITY_meta-odroidm1s = "6"

LAYERDEPENDS_meta-odroidm1s = "core"
LAYERSERIES_COMPAT_meta-odroidm1s = "nanbield scarthgap"
```

## conf/machine/odroid-m1s.conf
```bitbake
#@TYPE: Machine
#@NAME: odroid-m1s
#@DESCRIPTION: Machine configuration for odroid-m1s systems
#@MAINTAINER: Gustavo Branco <guster32@gmail.com>

require conf/machine/include/arm/armv8-2a/tune-cortexa55.inc
require conf/machine/include/soc-family.inc
require conf/machine/include/bootfiles.inc

SOC_FAMILY = "rockchip:rk3566"

PREFERRED_PROVIDER_virtual/kernel ?= "linux-yocto"
PREFERRED_VERSION_linux-yocto ?= "6.1%"
MACHINE_EXTRA_RRECOMMENDS = "kernel-modules kernel-devicetree"
KERNEL_IMAGETYPE = "Image"
KERNEL_DEVICETREE = "rockchip/rk3568-odroid-m1.dtb"

PREFERRED_PROVIDER_virtual/bootloader = "u-boot-hardkernel"
PREFERRED_PROVIDER_u-boot = "u-boot-hardkernel"
PREFERRED_VERSION_u-boot = "2017.09"

UBOOT_MACHINE = "odroid_rk3566_defconfig"
UBOOT_BINARY = "u-boot.bin"
UBOOT_LOAD_CMD = "load"
UBOOT_BOOTPART = "${partition}"
UBOOT_FILE_TITLE = "ODROIDM1-UBOOT-CONFIG"
UBOOT_EXTRA_ENV = "setenv bootlabel YOCTO WIC"
BOOT_PREFIX = ""
SERIAL_CONSOLES = "1500000;ttyS2"
UBOOT_CONSOLE = "console=ttyS2,1500000 earlycon"
UBOOT_ENTRYPOINT = "${kernel_addr_c}"
UBOOT_FDT_LOADADDR = "${fdt_addr_r}"
UBOOT_LOADADDRESS = "${kernel_addr_r}"

# We use booti and Image for booting an uncompressed Linux kernel image (Image) on ARM64 (AArch64) architecture
UBOOT_BOOT_CMD = "booti"
UBOOT_KERNEL_NAME = "Image"
UBOOT_ROOT_mmc = "mmcblk0p2"

UBOOT_ROOT_nvme = "nvme0n1p2"
UBOOT_ROOT = "${UBOOT_ROOT_mmc}"
UBOOT_ENV  = "boot"
UBOOT_ENV_SUFFIX ?= "scr"
ARCH = "arm64"
UBOOT_SCRIPT = "boot.${UBOOT_ENV_SUFFIX}"
IMAGE_BOOT_FILES = "${UBOOT_SCRIPT} ${KERNEL_IMAGETYPE} ${@make_dtb_boot_files(d)}"

PREFERRED_PROVIDER_virtual/gpu = "mesa"

IMAGE_FSTYPES = " ext4 wic wic.xz wic.bmap"
IMAGE_CLASSES += "image_types_odroid"
WIC_CREATE_EXTRA_ARGS = " --no-fstab-update "
WKS_FILE = "odroid-m1s.wks"
```

## wic/odroid-m1s.wks
```
# short-description: Create SD card image with a boot partition
# long-description:
# Create an image that can be written onto a SD card using dd for use
# with Odroid-m1s style boards .
# It uses SPL, and u-boot
#
# The disk layout used is:
#  -------------------------------------------
# | Area Name | From (sector #)| To (Sector #)|
# |-------------------------------------------|
# | SPL	      |  64	           | 1077         |
# | U-Boot	  |  2048	         | 6143         |
# | BOOT	    |  6144	         | 530431       |
# | rootfs	  |  530432	       | -            |
#  -------------------------------------------
#
part  --source bootimg-partition --ondisk mmcblk --fstype=ext2 --label boot --active --align 6144 --size 256
part  --source rootfs --ondisk mmcblk --fstype=ext4 --label rootfs --align 530432

bootloader --ptable msdos
```
